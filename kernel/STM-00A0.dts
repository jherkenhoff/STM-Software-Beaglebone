// This DTS overlay sets up the driver and the GPIO inputs and outputs for the
// scanning-tunneling microscope (STM) firmware

#include <dt-bindings/board/am335x-bbw-bbb-base.h>
#include <dt-bindings/pinctrl/am33xx.h>

/dts-v1/;
/plugin/;

/ {
    compatible = "ti,beaglebone", "ti,beaglebone-black";

    // identification
    part-number = "STM";
    version = "00A0";

    fragment@0 {
        target-path="/";
        __overlay__ {
            stm {
                compatible = "stm,stm";

                prus = <&pru0>, <&pru1>;

                // https://www.kernel.org/doc/Documentation/devicetree/bindings/interrupt-controller/interrupts.txt
                interrupt-parent = <&pruss_intc>;
                interrupts = <22>, <23>, <24>;
                interrupt-names = "from_bl_1", "to_bl", "from_bl_2";
            };
        };
    };
};
